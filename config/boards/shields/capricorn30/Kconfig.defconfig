## config/boards/shields/capricorn30/Kconfig.defconfig
```kconfig
if SHIELD_CAPRICORN30

config ZMK_KEYBOARD_NAME
    default "Capricorn30"

endif
```

## config/west.yml
```yaml
manifest:
  remotes:
    - name: WhyNotBro235
      url-base: https://github.com/WhyNotBro235
  projects:
    - name: zmk
      remote: WhyNotBro235
      revision: main
      import: app/west.yml
  self:
    path: config
```
